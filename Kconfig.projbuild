## Kconfig.projbuild
```kconfig
# Include component-specific configurations
rsource "components/axp2101_pmu/Kconfig"
rsource "components/pcf85063_rtc/Kconfig"
rsource "components/sleep_manager/Kconfig"
rsource "components/uptime_tracker/Kconfig"
rsource "main/Kconfig"
```

## components/axp2101_pmu/Kconfig
```kconfig
menu "App: Power Management"
    comment "Battery and charging configuration"
    
    config BATTERY_LOW_THRESHOLD
        int "Battery Low Threshold (%)"
        default 15
        range 5 30
        help
            Battery percentage below which low battery warning is shown.
    
    config BATTERY_CRITICAL_THRESHOLD
        int "Battery Critical Threshold (%)"
        default 5
        range 1 15
        help
            Battery percentage below which critical battery warning is shown.
    
    config DISABLE_BATTERY_CHARGING
        bool "Disable Battery Charging"
        default n
        help
            Disable battery charging via AXP2101 PMU.
            This is useful for testing power consumption without charging interference.
            WARNING: Only use this for testing. The battery will not charge while this is enabled.

    config BATTERY_CALIBRATION_CURVE
        bool "Use calibrated battery percentage curve"
        default y
        help
            Use a voltage-to-percentage lookup curve tuned for typical single-cell LiPo
            discharge behavior. Disable to fall back to the simple linear mapping.
endmenu
```

## components/ntp_client/Kconfig
```kconfig
menu "App: Time Synchronization"

    config NTP_CLIENT_ENABLE
        bool "Enable NTP time synchronization"
        depends on ENABLE_WIFI
        default y
        help
            Enable NTP client for time synchronization over WiFi.
            When disabled, time sync UI and NTP logic are not compiled.

    config NTP_SYNC_ON_WIFI_CONNECT
        bool "Sync time on WiFi connect"
        depends on NTP_CLIENT_ENABLE
        default y
        help
            Automatically start an NTP sync when WiFi connects.

    config NTP_SYNC_INTERVAL_MIN
        int "Minimum sync interval (minutes)"
        depends on NTP_CLIENT_ENABLE
        default 720
        range 10 10080
        help
            Minimum minutes between automatic sync attempts.
            Default is 12 hours.

    config NTP_DEFAULT_SERVER
        string "Default NTP server"
        depends on NTP_CLIENT_ENABLE
        default "pool.ntp.org"
        help
            Default NTP server hostname used when no custom server is saved.

    config NTP_DEFAULT_TIMEZONE
        string "Default time zone (UTC offset)"
        depends on NTP_CLIENT_ENABLE
        default "UTC+0"
        help
            Default time zone string in UTC offset format.
            Example: UTC-5, UTC+2

    config NTP_DEFAULT_DST
        bool "Default DST enabled"
        depends on NTP_CLIENT_ENABLE
        default n
        help
            Default Daylight Saving Time setting when no value is saved.

    config NTP_DEBUG_LOGS
        bool "Enable debug logs"
        depends on NTP_CLIENT_ENABLE
        default n
        help
            Enable verbose logs for NTP client.

endmenu
```

## components/ota_manager/Kconfig
```kconfig
menu "App: OTA Update Manager"

    config ENABLE_OTA
        bool "Enable OTA (Over-The-Air) updates"
        default y
        help
            Enable OTA update functionality for firmware updates.
            When disabled, OTA update UI and functionality won't be compiled.

    config OTA_UPDATE_URL
        string "Default OTA update URL"
        depends on ENABLE_OTA
        default "https://github.com/Asion001/esp32_watch/releases/latest/download/firmware.bin"
        help
            Default URL to check for firmware updates.
            Can be changed at runtime via OTA settings screen.
            Supports HTTP/HTTPS. GitHub releases URL recommended for CI/CD.

    config OTA_AUTO_CHECK
        bool "Automatically check for updates on WiFi connect"
        depends on ENABLE_OTA
        default n
        help
            Automatically check for firmware updates when WiFi connects.
            If update available, user will be notified.

    config OTA_CHECK_INTERVAL_HOURS
        int "Auto-check interval (hours)"
        depends on OTA_AUTO_CHECK
        default 24
        range 1 168
        help
            How often to check for updates when auto-check is enabled.
            Range: 1-168 hours (1 hour to 1 week).

    config OTA_BUFFER_SIZE
        int "OTA download buffer size (bytes)"
        depends on ENABLE_OTA
        default 4096
        range 1024 8192
        help
            Buffer size for OTA downloads.
            Larger values = faster downloads but more RAM usage.
            4096 bytes is a good balance for most use cases.

    config OTA_ENABLE_HTTPS
        bool "Enable HTTPS for OTA updates"
        depends on ENABLE_OTA
        default y
        help
            Enable HTTPS/TLS for secure OTA updates.
            Recommended for production. Requires valid server certificate.

    config OTA_ENABLE_ROLLBACK
        bool "Enable automatic rollback on boot failure"
        depends on ENABLE_OTA
        default y
        help
            Automatically rollback to previous firmware if new version fails to boot.
            Highly recommended for production deployments.

endmenu
```

## components/pcf85063_rtc/Kconfig
```kconfig
menu "App: RTC Configuration"

    config RTC_FORCE_SYNC_ON_BOOT
        bool "Force sync RTC to build time on every boot"
        default n
        help
            When enabled, RTC will be updated to build time on every boot.
            Useful during development to sync time with your computer.
            Disable in production to preserve RTC time across reboots.
            
            During development, enable this so every rebuild automatically
            syncs your watch to your computer's time.

endmenu
```

## components/screen_manager/Kconfig
```kconfig
menu "Screen Manager"

    config SCREEN_MANAGER_MAX_STACK_DEPTH
        int "Maximum navigation stack depth"
        default 8
        range 2 16
        help
            Maximum number of screens that can be in the navigation stack.
            Prevents memory issues from deep nesting.

endmenu
```

## components/sleep_manager/Kconfig
```kconfig
menu "App: Sleep Manager"

    config SLEEP_MANAGER_ENABLE
        bool "Enable Sleep Manager"
        default n
        help
            Enable automatic sleep on inactivity.
            When enabled, the device will enter sleep mode after a period of inactivity.

    config SLEEP_MANAGER_BACKLIGHT_TIMEOUT_SECONDS
        int "Backlight timeout (seconds)"
        depends on SLEEP_MANAGER_ENABLE
        default 10
        range 1 300
        help
            Time in seconds before turning off backlight due to inactivity.
            Backlight will turn off independently of sleep mode.

    config SLEEP_TIMEOUT_SECONDS
        int "Sleep timeout (seconds)"
        depends on SLEEP_MANAGER_ENABLE
        default 30
        range 5 300
        help
            Time in seconds before entering sleep mode due to inactivity.
            Should typically be longer than backlight timeout.

    config SLEEP_MANAGER_BACKLIGHT_CONTROL
        bool "Control display backlight"
        depends on SLEEP_MANAGER_ENABLE
        default y
        help
            Turn off display backlight during sleep.
            Disable for testing sleep without affecting display.

    config SLEEP_MANAGER_LVGL_TIMER_PAUSE
        bool "Pause LVGL timers during sleep"
        depends on SLEEP_MANAGER_ENABLE
        default y
        help
            Automatically pause all LVGL timers when entering sleep.
            Disable to keep watchface updating in background during sleep.

    config SLEEP_MANAGER_LVGL_RENDERING_CONTROL
        bool "Disable LVGL rendering during sleep"
        depends on SLEEP_MANAGER_ENABLE
        default y
        help
            Stop LVGL from rendering frames during sleep.
            Disable to allow LVGL to continue rendering (uses more power).

    config SLEEP_MANAGER_GPIO_WAKEUP
        bool "Enable GPIO wake-up"
        depends on SLEEP_MANAGER_ENABLE
        default y
        help
            Enable hardware wake-up sources (boot button).
            Disable to test sleep without wake-up capability.

    config SLEEP_MANAGER_TOUCH_WAKEUP
        bool "Enable touch screen wake-up"
        depends on SLEEP_MANAGER_GPIO_WAKEUP
        default y
        help
            Enable touch screen as wake-up source.
            Disable to save battery and require boot button press to wake.
            When disabled, only the boot button (GPIO9) will wake the watch.

    config SLEEP_MANAGER_TOUCH_RESET_TIMER
        bool "Reset timer on touch events"
        depends on SLEEP_MANAGER_ENABLE
        default y
        help
            Reset inactivity timer when user touches the screen.
            Disable to test automatic sleep regardless of touch activity.

    config SLEEP_MANAGER_PREVENT_SLEEP_ON_USB
        bool "Prevent sleep when USB/JTAG connected"
        depends on SLEEP_MANAGER_ENABLE
        default y
        help
            Prevent automatic sleep when USB power (VBUS) is detected.
            Useful during development to keep screen on while debugging.
            Uses AXP2101 PMU VBUS detection.

    config SLEEP_MANAGER_PREVENT_SCREEN_OFF_ON_USB
        bool "Prevent screen off when USB/JTAG connected"
        depends on SLEEP_MANAGER_ENABLE
        default n
        help
            Prevent turning off screen backlight when USB power (VBUS) is detected.
            Useful during development to keep display visible while debugging.
            Independent of sleep prevention - screen stays on even if device enters light sleep.
            Uses AXP2101 PMU VBUS detection.

    config SLEEP_MANAGER_DEBUG_LOGS
        bool "Enable debug logging"
        depends on SLEEP_MANAGER_ENABLE
        default n
        help
            Enable detailed debug logs for sleep manager operations.
            Useful for troubleshooting but increases log verbosity.

endmenu
```

## components/uptime_tracker/Kconfig
```kconfig
menu "App: Uptime Tracker"

    config UPTIME_TRACKER_ENABLE
        bool "Enable Uptime Tracker"
        default y
        help
            Enable persistent uptime tracking with NVS storage.
            Tracks current session uptime and total uptime across reboots.

    config UPTIME_TRACKER_SAVE_INTERVAL_SEC
        int "Save interval (seconds)"
        depends on UPTIME_TRACKER_ENABLE
        default 60
        range 10 3600
        help
            How often to save uptime data to NVS (in seconds).
            Lower values = more frequent saves but more flash wear.
            Higher values = less flash wear but more data loss on unexpected shutdown.

    config UPTIME_TRACKER_DEBUG_LOGS
        bool "Enable Debug Logs"
        depends on UPTIME_TRACKER_ENABLE
        default n
        help
            Enable verbose debug logging for Uptime Tracker.

endmenu
```

## components/wifi_manager/Kconfig
```kconfig
menu "App: WiFi Manager"

config WIFI_DEFAULT_CREDENTIALS_ENABLE
    bool "Enable default WiFi credentials"
    default n
    help
        Enable build-time default WiFi credentials used when no saved
        credentials exist in NVS.

config WIFI_DEFAULT_SSID
    string "Default WiFi SSID"
    default ""
    depends on WIFI_DEFAULT_CREDENTIALS_ENABLE
    help
        SSID for build-time default WiFi connection.

config WIFI_DEFAULT_PASSWORD
    string "Default WiFi password"
    default ""
    depends on WIFI_DEFAULT_CREDENTIALS_ENABLE
    help
        Password for build-time default WiFi connection.
        Leave empty for open networks.

endmenu
```

## main/Kconfig
```kconfig
menu "App: Display Configuration"
    comment "Watchface and UI settings"
    
    config WATCHFACE_UPDATE_INTERVAL_MS
        int "Watchface Update Interval (ms)"
        default 1000
        range 100 5000
        help
            How often to update the watchface display.
            Lower values = smoother updates but higher power consumption.
    
    config DISPLAY_TIMEOUT_MS
        int "Display Timeout (ms)"
        default 15000
        range 5000 300000
        help
            Time before display turns off due to inactivity.
endmenu

menu "App: Reliability"
    config APP_WATCHDOG_ENABLE
        bool "Enable task watchdog"
        default n
        help
            Enable a task watchdog to detect scheduler hangs.

    config APP_WATCHDOG_TIMEOUT_SECONDS
        int "Watchdog timeout (seconds)"
        depends on APP_WATCHDOG_ENABLE
        default 10
        range 2 60
        help
            Time in seconds before watchdog triggers if not fed.

    config APP_WATCHDOG_FEED_INTERVAL_MS
        int "Watchdog feed interval (ms)"
        depends on APP_WATCHDOG_ENABLE
        default 2000
        range 250 10000
        help
            How often the watchdog feed task resets the watchdog.
            Must be lower than the watchdog timeout.

    config APP_WATCHDOG_PANIC
        bool "Trigger panic on watchdog timeout"
        depends on APP_WATCHDOG_ENABLE
        default y
        help
            Trigger a panic and reboot on watchdog timeout.
endmenu

menu "App: WiFi Configuration"
    config ENABLE_WIFI
        bool "Enable WiFi functionality"
        default y
        help
            Enable WiFi manager and related UI screens.
            Disable this to save flash/RAM on devices that don't need WiFi.
            When disabled, WiFi menu items and screens won't be compiled.

    config WIFI_AUTO_CONNECT
        bool "Auto-connect to saved network on boot"
        depends on ENABLE_WIFI
        default y
        help
            Automatically connect to saved WiFi credentials on startup.
            If disabled, user must manually connect via settings.
endmenu



menu "App: Logging Configuration"
    comment "Application log verbosity settings"

    choice APP_LOG_LEVEL
        prompt "Default log verbosity"
        default APP_LOG_LEVEL_INFO
        help
            Specify how much output to see in logs by default.
            Note that this setting only affects the main application.
            Each component has its own log level setting.

        config APP_LOG_LEVEL_NONE
            bool "No output"
        config APP_LOG_LEVEL_ERROR
            bool "Error"
        config APP_LOG_LEVEL_WARN
            bool "Warning"
        config APP_LOG_LEVEL_INFO
            bool "Info"
        config APP_LOG_LEVEL_DEBUG
            bool "Debug"
        config APP_LOG_LEVEL_VERBOSE
            bool "Verbose"
    endchoice

    config APP_LOG_LEVEL
        int
        default 0 if APP_LOG_LEVEL_NONE
        default 1 if APP_LOG_LEVEL_ERROR
        default 2 if APP_LOG_LEVEL_WARN
        default 3 if APP_LOG_LEVEL_INFO
        default 4 if APP_LOG_LEVEL_DEBUG
        default 5 if APP_LOG_LEVEL_VERBOSE
endmenu
```
